## boards/shields/do42/Kconfig.defconfig
```kconfig
if SHIELD_DO42_LEFT

config ZMK_KEYBOARD_NAME
    default "do42"

config ZMK_SPLIT_ROLE_CENTRAL
    default y

endif

if SHIELD_DO42_LEFT || SHIELD_DO42_RIGHT
config ZMK_SPLIT
    default y
endif
```

## boards/shields/do42/Kconfig.shield
```kconfig
config SHIELD_DO42_LEFT
    def_bool $(shields_list_contains,do42_left)

config SHIELD_DO42_RIGHT
    def_bool $(shields_list_contains,do42_right)
```

## boards/shields/do52/Kconfig.defconfig
```kconfig
if SHIELD_DO52_LEFT

config ZMK_KEYBOARD_NAME
    default "do52"

config ZMK_SPLIT_ROLE_CENTRAL
    default y

endif

if SHIELD_DO52_LEFT || SHIELD_DO42_RIGHT
config ZMK_SPLIT
    default y
endif
```

## boards/shields/do52/Kconfig.shield
```kconfig
config SHIELD_DO52_LEFT
    def_bool $(shields_list_contains,do52_left)

config SHIELD_DO52_RIGHT
    def_bool $(shields_list_contains,do52_right)
```

## boards/shields/do52pro/Kconfig.defconfig
```kconfig
if SHIELD_DO52PRO_LEFT

config ZMK_KEYBOARD_NAME
    default "do52pro"

config ZMK_SPLIT_ROLE_CENTRAL
    default y

endif

if SHIELD_DO52PRO_LEFT || SHIELD_DO52PRO_RIGHT
config ZMK_SPLIT
    default y
endif
```

## boards/shields/do52pro/Kconfig.shield
```kconfig
config SHIELD_DO52PRO_LEFT
    def_bool $(shields_list_contains,do52pro_left)

config SHIELD_DO52PRO_RIGHT
    def_bool $(shields_list_contains,do52pro_right)
```

## boards/shields/do52pro_tp/Kconfig.defconfig
```kconfig
if SHIELD_DO52PRO_TP_RIGHT

config ZMK_KEYBOARD_NAME
    default "do52pro_tp"

config ZMK_SPLIT_ROLE_CENTRAL
    default y

endif

if SHIELD_DO52PRO_TP_LEFT || SHIELD_DO52PRO_TP_RIGHT
config ZMK_SPLIT
    default y
endif
```

## boards/shields/do52pro_tp/Kconfig.shield
```kconfig
config SHIELD_DO52PRO_TP_LEFT
    def_bool $(shields_list_contains,do52pro_tp_left)

config SHIELD_DO52PRO_TP_RIGHT
    def_bool $(shields_list_contains,do52pro_tp_right)
```
